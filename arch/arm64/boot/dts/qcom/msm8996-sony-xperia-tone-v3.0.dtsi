/* Copyright (c) 2014-2017, The Linux Foundation. All rights reserved.
 *
 * This program is free software; you can redistribute it and/or modify
 * it under the terms of the GNU General Public License version 2 and
 * only version 2 as published by the Free Software Foundation.
 */
/* Hardware data from the final Sony dora DT at
 * 0c295b15b6d0fb59a64e13b9e0ef2070818ef2a1, not intermediate includes.
 * Source data is retained while unsupported power chains remain disabled.
 */

/ { qcom,msm-id = <246 0x30000>; };

&tone_gfx_cpr {
	/delete-property/ qcom,cpr-aging-ref-voltage;
	system-supply = <&pm8994_s1_corner>;
};

&tone_gfx_vreg {
	/delete-property/ qcom,allow-aging-voltage-adjustment;
	qcom,corner-frequencies = <0x0 0xcc16180 0x12c684c0 0x17f2fb40 0x1e65fb80 0x2160ec00 0x25317c00>;
	/delete-property/ qcom,cpr-aging-max-voltage-adjustment;
	/delete-property/ qcom,cpr-aging-ref-corner;
	/delete-property/ qcom,cpr-aging-ro-scaling-factor;
	qcom,cpr-closed-loop-voltage-adjustment = <0x0 0xffffec78 0x4e20 0x4e20 0x7530 0x2710 0xffffec78 0x0
			0xffffec78 0x4e20 0x4e20 0x7530 0x2710 0xffffec78 0x0 0xea60
			0x9c40 0x9c40 0xafc8 0x61a8 0x88b8 0x0 0x7530 0x2710
			0x2710 0xafc8 0x61a8 0x61a8 0x0 0x7530 0x2710 0x2710
			0xafc8 0x61a8 0x61a8 0x0 0x7530 0x2710 0x2710 0xafc8
			0x61a8 0x61a8 0x0 0x7530 0x2710 0x2710 0xafc8 0x61a8
			0x61a8 0x0 0x7530 0x2710 0x2710 0xafc8 0x61a8 0x61a8>;
	qcom,cpr-corner-fmax-map = <0x2 0x3 0x5 0x7>;
	qcom,cpr-corners = <0x7>;
	qcom,cpr-floor-to-ceiling-max-range = <0x0 0x11170 0x124f8 0x13880 0x15f90 0x17318 0x186a0>;
	/delete-property/ qcom,cpr-fused-closed-loop-voltage-adjustment-map;
	qcom,cpr-open-loop-voltage-fuse-adjustment = <0x0 0x0 0x7530 0xffffd8f0 0xffff8ad0 0xffff8ad0 0x0 0xffffd8f0
			0xffff8ad0 0xffff8ad0 0x0 0xffffd8f0 0x0 0x0 0x0 0x0
			0x0 0x0 0x0 0x0 0x0 0x0 0x0 0x0
			0x0 0x0 0x0 0x0 0x0 0x0 0x0 0x0>;
	qcom,cpr-ro-scaling-factor = <0x0 0x0 0x0 0x0 0x0 0x0 0x7f3 0x77d
			0x7a7 0x853 0x8c6 0x8cd 0x0 0x0 0x0 0x0
			0x0 0x0 0x0 0x0 0x0 0x0 0x7f3 0x77d
			0x7a7 0x853 0x8c6 0x8cd 0x0 0x0 0x0 0x0
			0x0 0x0 0x0 0x0 0x0 0x0 0x7f3 0x77d
			0x7a7 0x853 0x8c6 0x8cd 0x0 0x0 0x0 0x0
			0x0 0x0 0x0 0x0 0x0 0x0 0x7f3 0x77d
			0x7a7 0x853 0x8c6 0x8cd 0x0 0x0 0x0 0x0
			0x0 0x0 0x0 0x0 0x0 0x0 0x7f3 0x77d
			0x7a7 0x853 0x8c6 0x8cd 0x0 0x0 0x0 0x0
			0x0 0x0 0x0 0x0 0x0 0x0 0x7f3 0x77d
			0x7a7 0x853 0x8c6 0x8cd 0x0 0x0 0x0 0x0
			0x0 0x0 0x0 0x0 0x0 0x0 0x7f3 0x77d
			0x7a7 0x853 0x8c6 0x8cd 0x0 0x0 0x0 0x0>;
	qcom,cpr-target-quotients = <0x0 0x0 0x0 0x0 0x0 0x0 0x0 0x0
			0x0 0x0 0x0 0x0 0x0 0x0 0x0 0x0
			0x0 0x0 0x0 0x0 0x0 0x0 0x11f 0x111
			0x1a9 0x1aa 0x1bb 0x1c5 0x0 0x0 0x0 0x0
			0x0 0x0 0x0 0x0 0x0 0x0 0x19e 0x188
			0x248 0x240 0x260 0x264 0x0 0x0 0x0 0x0
			0x0 0x0 0x0 0x0 0x0 0x0 0x1cb 0x1af
			0x2ac 0x284 0x2b4 0x2a7 0x0 0x0 0x0 0x0
			0x0 0x0 0x0 0x0 0x0 0x0 0x241 0x21f
			0x31e 0x300 0x337 0x32a 0x0 0x0 0x0 0x0
			0x0 0x0 0x0 0x0 0x0 0x0 0x29d 0x275
			0x376 0x360 0x39c 0x38f 0x0 0x0 0x0 0x0
			0x0 0x0 0x0 0x0 0x0 0x0 0x303 0x2d5
			0x3d8 0x3ca 0x40c 0x400 0x0 0x0 0x0 0x0>;
	qcom,cpr-voltage-ceiling = <0x61a80 0xa3930 0xb5e28 0xc96a8 0xdcf28 0xea600 0xf7cd8>;
	qcom,cpr-voltage-floor = <0x61a80 0x7ef40 0x7ef40 0x7ef40 0x7ef40 0x7ef40 0x7ef40>;
	qcom,mem-acc-voltage = <0x1 0x1 0x1 0x2 0x2 0x2 0x2>;
	qcom,system-voltage = <0x2 0x2 0x2 0x2 0x2 0x4 0x4>;
	regulator-max-microvolt = <0x7>;
};

&tone_gfx_cc {
	compatible = "qcom,msm8996-v3.0-gfxcc";
	qcom,gfxfreq-speedbin0 = <0x0 0x0 0x0 0x7ed6b40 0x3 0x4 0xcc16180 0x3
			0x4 0x12c684c0 0x3 0x4 0x17f2fb40 0x4 0x5 0x1e65fb80
			0x5 0x5 0x2160ec00 0x6 0x7 0x25317c00 0x7 0x7>;
};
