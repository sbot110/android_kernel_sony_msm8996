// SPDX-License-Identifier: BSD-3-Clause
/*
 * Sony Xperia X Performance F8131 / F8132 (MSM8996 v3.0 + PM8994 + PMI8994)
 */

#include "msm8996-sony-xperia-tone-dora.dts"
#include "msm8996-v3.0.dtsi"

/ {
	model = "SoMC Dora-ROW (Sony Xperia X Performance F8131/F8132 MSM8996 v3.0)";
	compatible = "somc,dora-row", "sony,dora-row", "qcom,msm8996";
	qcom,msm-id = <246 0x30000>;
	qcom,pmic-id = <0x20009 0x2000a 0 0>;
	qcom,board-id = <8 0>;
};
