## arch/arm64/configs/tone_dora_defconfig
```kconfig
# Sony dora: Linux 4.19 bring-up configuration, not a boot-tested port.
# See Documentation/sony/dora-source-base.txt and README_KERNEL_4.19.md.
CONFIG_LOCALVERSION="-dora-4.19"
# CONFIG_LOCALVERSION_AUTO is not set
CONFIG_SYSVIPC=y
CONFIG_POSIX_MQUEUE=y
CONFIG_AUDIT=y
CONFIG_NO_HZ_IDLE=y
CONFIG_HIGH_RES_TIMERS=y
CONFIG_PREEMPT=y
CONFIG_HZ_100=y
CONFIG_TASKSTATS=y
CONFIG_TASK_XACCT=y
CONFIG_TASK_IO_ACCOUNTING=y
CONFIG_IKCONFIG=y
CONFIG_IKCONFIG_PROC=y
CONFIG_CGROUPS=y
CONFIG_MEMCG=y
CONFIG_MEMCG_SWAP=y
CONFIG_BLK_CGROUP=y
CONFIG_CGROUP_SCHED=y
CONFIG_FAIR_GROUP_SCHED=y
CONFIG_CGROUP_CPUACCT=y
CONFIG_CGROUP_FREEZER=y
CONFIG_CGROUP_DEVICE=y
CONFIG_CGROUP_PIDS=y
CONFIG_CPUSETS=y
CONFIG_CGROUP_BPF=y
CONFIG_NAMESPACES=y
CONFIG_UTS_NS=y
CONFIG_IPC_NS=y
CONFIG_PID_NS=y
CONFIG_NET_NS=y
CONFIG_PSI=y
CONFIG_BPF_SYSCALL=y
CONFIG_BPF_JIT=y
CONFIG_MEMBARRIER=y
CONFIG_BLK_DEV_INITRD=y
CONFIG_KALLSYMS_ALL=y
CONFIG_ARCH_QCOM=y
CONFIG_SMP=y
CONFIG_NR_CPUS=4
CONFIG_COMPAT=y
CONFIG_COMPAT_VDSO=y
CONFIG_BUILD_ARM64_APPENDED_DTB_IMAGE=y
CONFIG_IMG_GZ_DTB=y
CONFIG_BUILD_ARM64_APPENDED_DTB_IMAGE_NAMES="qcom/msm8996-sony-xperia-tone-dora"
CONFIG_SECCOMP=y
CONFIG_MODULES=y
CONFIG_MODULE_UNLOAD=y
CONFIG_MODVERSIONS=y
CONFIG_PARTITION_ADVANCED=y
CONFIG_PM_AUTOSLEEP=y
CONFIG_PM_WAKELOCKS=y
CONFIG_NET=y
CONFIG_PACKET=y
CONFIG_UNIX=y
CONFIG_INET=y
CONFIG_IP_MULTICAST=y
CONFIG_IP_ADVANCED_ROUTER=y
CONFIG_IP_MULTIPLE_TABLES=y
CONFIG_INET_ESP=y
CONFIG_INET_UDP_DIAG=y
CONFIG_INET_DIAG_DESTROY=y
CONFIG_IPV6=y
CONFIG_IPV6_MULTIPLE_TABLES=y
CONFIG_NETFILTER=y
CONFIG_NF_CONNTRACK=y
CONFIG_NF_CONNTRACK_EVENTS=y
CONFIG_NETFILTER_XT_MARK=y
CONFIG_NETFILTER_XT_TARGET_IDLETIMER=y
CONFIG_NETFILTER_XT_MATCH_BPF=y
CONFIG_NETFILTER_XT_MATCH_COMMENT=y
CONFIG_NETFILTER_XT_MATCH_CONNTRACK=y
CONFIG_NETFILTER_XT_MATCH_OWNER=y
CONFIG_NETFILTER_XT_MATCH_QUOTA=y
CONFIG_IP_NF_IPTABLES=y
CONFIG_IP_NF_FILTER=y
CONFIG_IP_NF_TARGET_REJECT=y
CONFIG_IP_NF_NAT=y
CONFIG_IP_NF_TARGET_MASQUERADE=y
CONFIG_IP6_NF_IPTABLES=y
CONFIG_IP6_NF_FILTER=y
CONFIG_IP6_NF_TARGET_REJECT=y
CONFIG_NET_SCHED=y
CONFIG_NET_SCH_HTB=y
CONFIG_NET_SCH_INGRESS=y
CONFIG_NET_CLS_U32=y
CONFIG_NET_CLS_BPF=y
CONFIG_NET_CLS_ACT=y
CONFIG_NET_ACT_BPF=y
CONFIG_NET_ACT_POLICE=y
CONFIG_NET_ACT_GACT=y
CONFIG_NET_ACT_MIRRED=y
CONFIG_CFG80211=y
CONFIG_RFKILL=y
CONFIG_PCI=y
CONFIG_PCI_MSI=y
CONFIG_PCIE_QCOM=y
CONFIG_PCI_MSM=y
CONFIG_DEVTMPFS=y
CONFIG_DEVTMPFS_MOUNT=y
CONFIG_BLK_DEV_LOOP=y
CONFIG_ZSMALLOC=y
CONFIG_ZRAM=y
CONFIG_NETDEVICES=y
CONFIG_TUN=y
CONFIG_INPUT_EVDEV=y
CONFIG_INPUT_MISC=y
CONFIG_KEYBOARD_GPIO=y
CONFIG_INPUT_UINPUT=y
CONFIG_SERIAL_MSM=y
CONFIG_SERIAL_MSM_CONSOLE=y
CONFIG_HW_RANDOM=y
CONFIG_HW_RANDOM_MSM_LEGACY=y
CONFIG_I2C=y
CONFIG_I2C_CHARDEV=y
CONFIG_I2C_QUP=y
CONFIG_SPI=y
CONFIG_SPI_QUP=y
CONFIG_SPMI=y
CONFIG_PINCTRL_MSM8996=y
CONFIG_GPIO_SYSFS=y
CONFIG_POWER_RESET_QCOM_PON=y
CONFIG_THERMAL=y
CONFIG_QCOM_TSENS=y
CONFIG_MFD_SPMI_PMIC=y
CONFIG_REGULATOR=y
CONFIG_REGULATOR_FIXED_VOLTAGE=y
CONFIG_REGULATOR_QCOM_SMD_RPM=y
CONFIG_REGULATOR_QCOM_SPMI=y
CONFIG_COMMON_CLK_QCOM=y
CONFIG_QCOM_CLK_SMD_RPM=y
CONFIG_MSM_GCC_8996=y
CONFIG_MSM_MMCC_8996=y
CONFIG_QCOM_QFPROM=y
CONFIG_NVMEM=y
CONFIG_HWSPINLOCK=y
CONFIG_HWSPINLOCK_QCOM=y
CONFIG_MAILBOX=y
CONFIG_QCOM_SMEM=y
CONFIG_RPMSG_QCOM_SMD=y
CONFIG_QCOM_SMD_RPM=y
CONFIG_QCOM_SMP2P=y
CONFIG_QCOM_BUS_SCALING=y
CONFIG_QCOM_SCM=y
CONFIG_SCSI=y
CONFIG_BLK_DEV_SD=y
CONFIG_SCSI_UFSHCD=y
CONFIG_SCSI_UFSHCD_PLATFORM=y
CONFIG_SCSI_UFS_QCOM=y
CONFIG_PHY_QCOM_UFS=y
CONFIG_PHY_QCOM_QMP=y
CONFIG_MMC=y
CONFIG_MMC_SDHCI=y
CONFIG_MMC_SDHCI_PLTFM=y
CONFIG_MMC_SDHCI_MSM=y
CONFIG_MD=y
CONFIG_BLK_DEV_DM=y
CONFIG_DM_CRYPT=y
CONFIG_DM_VERITY=y
CONFIG_DM_VERITY_FEC=y
CONFIG_IOMMU_SUPPORT=y
CONFIG_ARM_SMMU=y
CONFIG_STAGING=y
CONFIG_ION=y
CONFIG_ION_SYSTEM_HEAP=y
CONFIG_SYNC_FILE=y
CONFIG_QCOM_KGSL=y
CONFIG_SOUND=y
CONFIG_SND=y
CONFIG_SND_SOC=y
CONFIG_FB=y
CONFIG_FB_MSM=y
CONFIG_FB_MSM_MDSS=y
CONFIG_BACKLIGHT_LCD_SUPPORT=y
CONFIG_BACKLIGHT_CLASS_DEVICE=y
CONFIG_USB=y
CONFIG_USB_XHCI_HCD=y
CONFIG_USB_DWC3=y
CONFIG_USB_DWC3_QCOM=y
CONFIG_USB_GADGET=y
CONFIG_USB_CONFIGFS=y
CONFIG_USB_CONFIGFS_F_FS=y
CONFIG_USB_CONFIGFS_F_MTP=y
CONFIG_USB_CONFIGFS_F_PTP=y
CONFIG_USB_CONFIGFS_F_ACC=y
CONFIG_USB_CONFIGFS_RNDIS=y
CONFIG_USB_STORAGE=y
CONFIG_USB_ULPI=y
CONFIG_EXTCON=y
CONFIG_ANDROID=y
CONFIG_ANDROID_BINDER_IPC=y
CONFIG_ANDROID_BINDERFS=y
CONFIG_ANDROID_BINDER_DEVICES="binder,hwbinder,vndbinder"
CONFIG_ASHMEM=y
CONFIG_EXT4_FS=y
CONFIG_EXT4_FS_POSIX_ACL=y
CONFIG_EXT4_FS_SECURITY=y
CONFIG_EXT4_ENCRYPTION=y
CONFIG_F2FS_FS=y
CONFIG_F2FS_FS_SECURITY=y
CONFIG_F2FS_FS_ENCRYPTION=y
CONFIG_QUOTA=y
CONFIG_QFMT_V2=y
CONFIG_FUSE_FS=y
CONFIG_INCREMENTAL_FS=y
CONFIG_OVERLAY_FS=y
CONFIG_VFAT_FS=y
CONFIG_TMPFS=y
CONFIG_TMPFS_POSIX_ACL=y
CONFIG_SQUASHFS=y
CONFIG_SQUASHFS_LZ4=y
CONFIG_PSTORE=y
CONFIG_PSTORE_CONSOLE=y
CONFIG_PSTORE_RAM=y
CONFIG_SECURITY=y
CONFIG_SECURITY_NETWORK=y
CONFIG_SECURITY_SELINUX=y
CONFIG_SECURITY_SELINUX_CHECKREQPROT_VALUE=0
CONFIG_DEFAULT_SECURITY_SELINUX=y
CONFIG_HARDENED_USERCOPY=y
CONFIG_CRYPTO_SHA256=y
CONFIG_CRYPTO_AES=y
CONFIG_CRYPTO_LZ4=y
CONFIG_PRINTK_TIME=y
CONFIG_DEBUG_KERNEL=y
CONFIG_DEBUG_FS=y
# CONFIG_DEBUG_INFO is not set
```

## drivers/net/wireless/controlfnc/Kconfig
```kconfig
config WIFI_CONTROL_FUNC
	bool "Sony WiFi power and PCIe control"
	depends on BCMDHD_PCIE && PCI_MSM
	help
	  Sony tone board power sequencing and PCIe enumeration for BCMDHD.
```

## drivers/platform/somc/Kconfig
```kconfig
# SPDX-License-Identifier: GPL-2.0-only
menuconfig SOMC_PLATFORMS
	bool "Sony Mobile (SOMC) Xperia platform drivers"
	depends on ARCH_QCOM || COMPILE_TEST
	default y if ARCH_QCOM
	help
	  Platform integration, SIM/hybrid-tray detection, FPC1145 TEE
	  fingerprint control, and Sony userspace sysfs compatibility bridges
	  for Sony Xperia Tone / Dora (MSM8996) devices.

if SOMC_PLATFORMS

config SOMC_DORA_PLATFORM
	tristate "Sony Xperia X Performance (dora F8131/F8132) platform & FPC1145 driver"
	depends on OF && GPIOLIB && REGULATOR
	default y
	help
	  Provides hardware integration for Sony Xperia X Performance
	  (F8131 Single SIM and F8132 Dual SIM):
	  - SIM1 (GPIO 112) and hybrid UIM2/SD tray (GPIO 29) state & wakeup
	  - FPC1145 / FPC1020 TrustZone fingerprint reset/IRQ/regulator control
	  - Userspace sysfs compatibility nodes expected by Sony init.qcom.rc
	    (clearpad wakeup_gesture/cover_mode, boot_adsp/boot_slpi, and
	    bcmdhd firmware_path/nvram_path parameters).

endif # SOMC_PLATFORMS
```

## techpack/audio/Kconfig
```kconfig
# SPDX-License-Identifier: GPL-2.0-only
config SND_SOC_SONY_MSM8996
	bool "Sony MSM8996 Tasha vendor sound card"
	depends on SND_SOC && ARCH_QCOM && QCOM_SMEM && MAILBOX
	select SWITCH
	select SND_DYNAMIC_MINORS
	select SND_HWDEP
	select SND_SOC_COMPRESS
	select SLIMBUS
	select SLIMBUS_MSM_NGD
	select SPI
	select I2C
	select REGMAP_SPI
	select SPS
	select SPS_SUPPORT_NDP_BAM
	select RPMSG_QCOM_SMD
	select QRTR
	select QRTR_SMD
	select QCOM_QMI_HELPERS
	select MSM_SUBSYSTEM_RESTART
	select MSM_PIL
	select MSM_PIL_SSR_GENERIC
	select MSM_EXT_DISPLAY
	help
	  Sony MSM8996 machine driver and the existing vendor APRv2/WCD9335
	  audio stack. This is distinct from the upstream APQ8096 sound card.
	  Requires the matching Sony audio DT, firmware and userspace routes.
```
